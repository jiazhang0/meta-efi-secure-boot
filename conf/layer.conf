## conf/layer.conf
```bitbake
#
# Copyright (C) 2017 Wind River Systems, Inc.
#

# We have a conf and classes directory, add to BBPATH
BBPATH =. "${LAYERDIR}:"

# We have a packages directory, add to BBFILES
BBFILES += "${LAYERDIR}/recipes-*/*/*.bb \
        ${LAYERDIR}/recipes-*/*/*.bbappend"

BBFILE_COLLECTIONS += "meta-efi-secure-boot"
BBFILE_PATTERN_meta-efi-secure-boot = "^${LAYERDIR}/"
BBFILE_PRIORITY_meta-efi-secure-boot = "7"

# This should only be incremented on significant changes that will
# cause compatibility issues with other layers
LAYERVERSION_meta-efi-secure-boot = "1"

LAYERDEPENDS_meta-efi-secure-boot = "\
    core \
    openembedded-layer \
    meta-signing-key \
"
```
